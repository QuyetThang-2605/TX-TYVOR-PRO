## tyvor-os-v1/esp32/boards/esp32s3_tft/main/Kconfig.projbuild
```kconfig
menu "TYVOR bench bridge"
    config TYVOR_UART_PINOUT_VERIFIED
        bool "Actual board UART pins and electrical wiring have been verified"
        default y
    config TYVOR_UART_TX_GPIO
        int "Verified UART TX GPIO (-1 = disabled)"
        range -1 48
        default 17
    config TYVOR_UART_RX_GPIO
        int "Verified UART RX GPIO (-1 = disabled)"
        range -1 48
        default 18
endmenu
```

## tyvor-os-v1/esp32/boards/esp32s3_tft/sdkconfig.defaults
```kconfig
CONFIG_IDF_TARGET="esp32s3"
CONFIG_ESPTOOLPY_FLASHMODE_QIO=y
CONFIG_ESPTOOLPY_FLASHSIZE_8MB=y
CONFIG_PARTITION_TABLE_CUSTOM=y
CONFIG_PARTITION_TABLE_CUSTOM_FILENAME="partitions.csv"
CONFIG_SPIRAM=y
CONFIG_SPIRAM_MODE_QUAD=y
CONFIG_SPIRAM_SPEED_40M=y
CONFIG_SPIRAM_USE_MALLOC=y
CONFIG_SPIRAM_IGNORE_NOTFOUND=y
CONFIG_ESP_CONSOLE_UART_DEFAULT=y
CONFIG_ESP_CONSOLE_SECONDARY_USB_SERIAL_JTAG=y
CONFIG_FREERTOS_HZ=1000
CONFIG_ESP_MAIN_TASK_STACK_SIZE=16384
CONFIG_ESP_TASK_WDT_EN=y
CONFIG_ESP_TASK_WDT_INIT=y
CONFIG_ESP_TASK_WDT_TIMEOUT_S=10
CONFIG_TYVOR_UART_PINOUT_VERIFIED=y
CONFIG_TYVOR_UART_TX_GPIO=17
CONFIG_TYVOR_UART_RX_GPIO=18
```

## tyvor-os-v1/esp32/experiments/tft_spi_320x240/main/Kconfig.projbuild
```kconfig
# Reuse existing UART defaults without modifying the original project.
rsource "../../../main/Kconfig.projbuild"
menu "TYVOR TFT experiment"
    config TYVOR_TFT_HARDWARE_GATE
        bool "Enable verified TFT hardware (never enable for an unidentified board/module)"
        default n
    config TYVOR_TFT_BOARD_VERIFIED
        bool "Actual ESP board routing/power has been verified"
        default n
    config TYVOR_TFT_MODULE_VERIFIED
        bool "Actual TFT controller/pinout/power has been verified"
        default n
    config TYVOR_TFT_ROTATION
        int "Orientation: 0=portrait,1=landscape,2=portrait inverted,3=landscape inverted"
        range 0 3
        default 0
    config TYVOR_TFT_BGR
        bool "BGR element order (verify separately from RGB565 byte order)"
        default n
    config TYVOR_TFT_BACKLIGHT_ACTIVE_LOW
        bool "Backlight control is active-low on the verified module"
        default n
    config TYVOR_TFT_SIMULATOR
        bool "Use explicitly labelled UI simulator fixtures"
        default y
    config TYVOR_TFT_BOOT_DIAGNOSTICS
        bool "Run colour/geometry/rotation diagnostics before UI"
        default y
    config TYVOR_TFT_TOUCH_RUNTIME
        bool "SPI touch runtime (unsupported until actual IC verification)"
        default n
    config TYVOR_TFT_SCLK
        int "Verified TFT SCLK (-1=unassigned)"
        range -1 48
        default -1
    config TYVOR_TFT_MOSI
        int "Verified TFT MOSI (-1=unassigned)"
        range -1 48
        default -1
    config TYVOR_TFT_MISO
        int "Verified TFT MISO, optional (-1=unassigned)"
        range -1 48
        default -1
    config TYVOR_TFT_CS
        int "Verified TFT CS (-1=unassigned)"
        range -1 48
        default -1
    config TYVOR_TFT_DC
        int "Verified TFT DC (-1=unassigned)"
        range -1 48
        default -1
    config TYVOR_TFT_RESET
        int "Verified TFT RESET (-1=unassigned)"
        range -1 48
        default -1
    config TYVOR_TFT_BACKLIGHT
        int "Verified backlight control, optional (-1=unassigned)"
        range -1 48
        default -1
endmenu
```

## tyvor-os-v1/esp32/experiments/tyvor_ui_v3_2/sdkconfig.defaults
```kconfig
CONFIG_IDF_TARGET="esp32s3"
CONFIG_ESPTOOLPY_FLASHSIZE_16MB=y
CONFIG_ESPTOOLPY_FLASHMODE_DIO=y
CONFIG_ESPTOOLPY_FLASHFREQ_80M=y
CONFIG_PARTITION_TABLE_CUSTOM=y
CONFIG_PARTITION_TABLE_CUSTOM_FILENAME="partitions.csv"
CONFIG_SPIRAM=y
CONFIG_SPIRAM_MODE_OCT=y
CONFIG_SPIRAM_SPEED_40M=y
CONFIG_SPIRAM_USE_MALLOC=y
CONFIG_SPIRAM_IGNORE_NOTFOUND=y
CONFIG_ESP_CONSOLE_USB_SERIAL_JTAG=y
CONFIG_ESP_CONSOLE_SECONDARY_NONE=y
CONFIG_FREERTOS_HZ=1000
CONFIG_FREERTOS_CHECK_STACKOVERFLOW_CANARY=y
CONFIG_HEAP_POISONING_LIGHT=y
CONFIG_ESP_TASK_WDT_EN=y
CONFIG_ESP_TASK_WDT_INIT=y
CONFIG_ESP_TASK_WDT_PANIC=y
# CONFIG_TYVOR_UART_PINOUT_VERIFIED is not set
CONFIG_TYVOR_UART_TX_GPIO=-1
CONFIG_TYVOR_UART_RX_GPIO=-1
# CONFIG_TYVOR_TFT_HARDWARE_GATE is not set
# CONFIG_TYVOR_TFT_BOARD_VERIFIED is not set
# CONFIG_TYVOR_TFT_MODULE_VERIFIED is not set
# CONFIG_TYVOR_TFT_TOUCH_RUNTIME is not set
CONFIG_TYVOR_TFT_SIMULATOR=y
CONFIG_TYVOR_TFT_BOOT_DIAGNOSTICS=y
CONFIG_TYVOR_TFT_ROTATION=1
CONFIG_TYVOR_TFT_SCLK=-1
CONFIG_TYVOR_TFT_MOSI=-1
CONFIG_TYVOR_TFT_MISO=-1
CONFIG_TYVOR_TFT_CS=-1
CONFIG_TYVOR_TFT_DC=-1
CONFIG_TYVOR_TFT_RESET=-1
CONFIG_TYVOR_TFT_BACKLIGHT=-1
```

## tyvor-os-v1/esp32/main/Kconfig.projbuild
```kconfig
menu "TYVOR bench bridge"
    config TYVOR_UART_PINOUT_VERIFIED
        bool "Actual board UART pins and electrical wiring have been verified"
        default n
        help
            Keep disabled until both board schematics and 3.3 V levels are checked.
            No panel/touch pins are configured by this project.
    config TYVOR_UART_TX_GPIO
        int "Verified UART TX GPIO (-1 = disabled)"
        range -1 48
        default -1
    config TYVOR_UART_RX_GPIO
        int "Verified UART RX GPIO (-1 = disabled)"
        range -1 48
        default -1
endmenu
```

## tyvor-os-v1/esp32/sdkconfig.defaults
```kconfig
CONFIG_IDF_TARGET="esp32s3"
CONFIG_ESPTOOLPY_FLASHMODE_QIO=y
CONFIG_ESPTOOLPY_FLASHSIZE_16MB=y
CONFIG_PARTITION_TABLE_CUSTOM=y
CONFIG_PARTITION_TABLE_CUSTOM_FILENAME="partitions.csv"
CONFIG_SPIRAM=y
CONFIG_SPIRAM_MODE_OCT=y
CONFIG_SPIRAM_SPEED_40M=y
CONFIG_SPIRAM_USE_MALLOC=y
CONFIG_SPIRAM_IGNORE_NOTFOUND=y
CONFIG_ESP_CONSOLE_USB_SERIAL_JTAG=y
CONFIG_ESP_CONSOLE_SECONDARY_NONE=y
CONFIG_FREERTOS_HZ=1000
CONFIG_FREERTOS_CHECK_STACKOVERFLOW_CANARY=y
CONFIG_HEAP_POISONING_LIGHT=y
CONFIG_ESP_TASK_WDT_EN=y
CONFIG_ESP_TASK_WDT_INIT=y
CONFIG_ESP_TASK_WDT_PANIC=y
# Pinout gate enabled for inter-MCU UART test (TX=GPIO17, RX=GPIO18).
CONFIG_TYVOR_UART_PINOUT_VERIFIED=y
CONFIG_TYVOR_UART_TX_GPIO=17
CONFIG_TYVOR_UART_RX_GPIO=18
```
